## app/boards/arm/app_nucleo_l476rg/Kconfig.board
```kconfig
# STM32L476RG Nucleo board configuration

# Copyright (c) 2016 Open-RnD Sp. z o.o.
# Copyright (c) 2016 BayLibre, SAS
# SPDX-License-Identifier: Apache-2.0

config BOARD_APP_NUCLEO_L476RG
	bool "App Nucleo L476RG Development Board"
	depends on SOC_STM32L476XX
```

## app/tests/ble/testcase.yaml
```yaml
tests:
  # section.subsection
  app.ble_concurrent_roles:
    platform_allow: native_posix
    tags: unit  
  app.ble_peripheral_hr:
    platform_allow: native_posix
    tags: unit
   
```

## app/tests/ble_peripheral_hr/testcase.yaml
```yaml
tests:
  # section.subsection
  app.ble_peripheral_hr:
    platform_allow: native_posix
    tags: unit
```

## app/tests/supervisor/testcase.yaml
```yaml
tests:
  # section.subsection
  app.supervisor:
    platform_allow: native_posix
    tags: unit
    tests: ./
```

## app/west.yml
```yaml
# Copyright (c) 2023 Motus Performance

manifest:
  remotes:
    - name: zephyr-app
      url-base: https://github.com/motus-engineering/zephyr-app
    - name: zephyrproject-rtos
      url-base: https://github.com/zephyrproject-rtos

  projects:
    - name: zephyr
      remote: zephyrproject-rtos
      revision: v3.5.0
      west-commands: scripts/west-commands.yml
      import:
        name-allowlist:
          - cmsis
          - hal_stm32
          - segger
          - bsim
          - tinycrypt
          - net-tools
          - hal_nordic
          - nrf_hw_models
          - babblesim_base
          - babblesim_ext_2G4_libPhyComv1
          - babblesim_ext_2G4_phy_v1
          - babblesim_ext_2G4_channel_NtNcable
          - babblesim_ext_2G4_channel_multiatt
          - babblesim_ext_2G4_modem_magic
          - babblesim_ext_2G4_modem_BLE_simple
          - babblesim_ext_2G4_device_burst_interferer
          - babblesim_ext_2G4_device_WLAN_actmod
          - babblesim_ext_2G4_device_playback
          - babblesim_ext_libCryptov1

      clone-depth: 1

  self:
    west-commands: scripts/west-commands.yml
```
